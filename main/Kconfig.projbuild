## main/Kconfig.projbuild
```kconfig
menu "FollowMe2 Configuration"

    config ESP_WIFI_SSID
        string "WiFi SSID"
        default "https://hessian.cn/followme2"
        help
            SSID (network name) for the app to connect to.

    config ESP_WIFI_PASSWORD
        string "WiFi Password"
        default "followme2"
        help
            WiFi password (WPA or WPA2) for the app to use.
    config ESP_WIFI_CHANNEL
        int "WiFi Channel"
        range 1 13
        default 1
        help
            WiFi channel (network channel) for the app to use.

    config ESP_MAX_STA_CONN
        int "Maximal STA connections"
        default 4
        help
            Max number of the STA connects to AP.
endmenu
```
